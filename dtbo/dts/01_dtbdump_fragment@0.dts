/dts-v1/;

/ {

	fragment@0 {
		target = <0xffffffff>;

		__overlay__ {
			#address-cells = <0x02>;
			#size-cells = <0x02>;
			ranges;

			zmc-default {
				compatible = "mediatek,zone_movable_cma";
				size = <0x00 0xffc00000>;
				alignment = <0x00 0x10000000>;
				alloc-ranges = <0x00 0xc0000000 0x01 0x00>;
			};
		};
	};

	fragment@1 {
		target = <0xffffffff>;

		__overlay__ {
			atag,videolfb-fb_base_h = <0x00>;
			atag,videolfb-fb_base_l = "^`P";
			atag,videolfb-islcmfound = <0x01>;
			atag,videolfb-islcm_inited = <0x00>;
			atag,videolfb-fps = <0x1770>;
			atag,videolfb-vramSize = <0x17bb000>;
			atag,videolfb-lcmname = "nt35695B_fhd_dsi_cmd_auo_rt5081_drv";
		};
	};

	fragment@2 {
		target = <0xffffffff>;

		__overlay__ {

			led@0 {
				compatible = "mediatek,red";
				led_mode = <0x00>;
				data = <0x01>;
				pwm_config = <0x00 0x00 0x00 0x00 0x00>;
				linux,phandle = <0x58>;
				phandle = <0x58>;
			};

			led@1 {
				compatible = "mediatek,green";
				led_mode = <0x00>;
				data = <0x01>;
				pwm_config = <0x00 0x00 0x00 0x00 0x00>;
				linux,phandle = <0x59>;
				phandle = <0x59>;
			};

			led@2 {
				compatible = "mediatek,blue";
				led_mode = <0x00>;
				data = <0x01>;
				pwm_config = <0x00 0x00 0x00 0x00 0x00>;
				linux,phandle = <0x5a>;
				phandle = <0x5a>;
			};

			led@3 {
				compatible = "mediatek,jogball-backlight";
				led_mode = <0x00>;
				data = <0x01>;
				pwm_config = <0x00 0x00 0x00 0x00 0x00>;
				linux,phandle = <0x5b>;
				phandle = <0x5b>;
			};

			led@4 {
				compatible = "mediatek,keyboard-backlight";
				led_mode = <0x00>;
				data = <0x01>;
				pwm_config = <0x00 0x00 0x00 0x00 0x00>;
				linux,phandle = <0x5c>;
				phandle = <0x5c>;
			};

			led@5 {
				compatible = "mediatek,button-backlight";
				led_mode = <0x00>;
				data = <0x01>;
				pwm_config = <0x00 0x00 0x00 0x00 0x00>;
				linux,phandle = <0x5d>;
				phandle = <0x5d>;
			};

			led@6 {
				compatible = "mediatek,lcd-backlight";
				led_mode = <0x05>;
				data = <0x01>;
				pwm_config = <0x00 0x03 0x00 0x00 0x00>;
				linux,phandle = <0x5e>;
				phandle = <0x5e>;
			};

			vibrator@0 {
				compatible = "mediatek,vibrator";
				vib_timer = <0x19>;
				vib_limit = <0x09>;
				vib_vol = <0x0d>;
				linux,phandle = <0x5f>;
				phandle = <0x5f>;
			};
		};
	};

	fragment@3 {
		target = <0xffffffff>;

		__overlay__ {

			msensor@0d {
				i2c_num = <0x01>;
				i2c_addr = <0x0c 0x00 0x00 0x00>;
				direction = <0x00>;
				power_id = <0xffff>;
				power_vol = <0x00>;
				is_batch_supported = <0x00>;
			};

			gyro@68 {
				i2c_num = <0x01>;
				i2c_addr = <0x68 0x00 0x00 0x00>;
				direction = <0x04>;
				power_id = <0xffff>;
				power_vol = <0x00>;
				firlen = <0x00>;
				is_batch_supported = <0x00>;
			};

			barometer@77 {
				i2c_num = <0x01>;
				i2c_addr = <0x77 0x00 0x00 0x00>;
				direction = <0x00>;
				power_id = <0xffff>;
				power_vol = <0x00>;
				firlen = <0x20>;
				is_batch_supported = <0x00>;
			};
		};
	};

	fragment@4 {
		target = <0xffffffff>;

		__overlay__ {

			alsps@51 {
				pinctrl-names = "pin_default\0pin_cfg";
				pinctrl-0 = <0x01>;
				pinctrl-1 = <0x02>;
				status = "okay";
				i2c_num = <0x01>;
				i2c_addr = <0x67 0x00 0x00 0x00>;
				polling_mode_ps = <0x00>;
				polling_mode_als = <0x01>;
				power_id = <0xffff>;
				power_vol = <0x00>;
				als_level = <0x0a 0x32 0x64 0xc8 0x190 0x2bc 0x3e8 0x5dc 0x898 0xbb8 0xdac 0xfa0 0x1194 0x1388 0x157c>;
				als_value = <0x00 0x32 0x64 0xc8 0x15e 0x258 0x44c 0x5dc 0x898 0xbb8 0xfa0 0x1770 0x1f40 0x2710 0x4e20 0x4e20>;
				ps_threshold_high = <0x2742>;
				ps_threshold_low = <0x2710>;
				is_batch_supported_ps = <0x00>;
				is_batch_supported_als = <0x00>;
			};
		};
	};

	fragment@5 {
		target = <0xffffffff>;

		__overlay__ {
			status = "okay";
		};
	};

	fragment@6 {
		target = <0xffffffff>;

		__overlay__ {
			#address-cells = <0x01>;
			#size-cells = <0x00>;
			clock-frequency = <0x61a80>;

			mtk-usb@60 {
				compatible = "mediatek,mtk-usb";
				reg = <0x60>;
				status = "okay";
			};
		};
	};

	fragment@7 {
		target = <0xffffffff>;

		__overlay__ {
			tpd-resolution = <0x438 0x924>;
			use-tpd-button = <0x00>;
			tpd-key-num = <0x03>;
			tpd-key-local = <0x8b 0xac 0x9e 0x00>;
			tpd-key-dim-local = <0x5a 0x373 0x64 0x28 0xe6 0x373 0x64 0x28 0x172 0x373 0x64 0x28 0x00 0x00 0x00 0x00>;
			tpd-max-touch-num = <0x05>;
			tpd-filter-enable = <0x00>;
			tpd-filter-pixel-density = <0x6a>;
			tpd-filter-custom-prameters = <0x00 0x00 0x00 0x00 0x00 0x00 0x00 0x00 0x00 0x00 0x00 0x00>;
			tpd-filter-custom-speed = <0x00 0x00 0x00>;
			pinctrl-names = "default\0state_eint_as_int\0state_eint_output0\0state_eint_output1\0state_rst_output0\0state_rst_output1";
			pinctrl-0 = <0x03>;
			pinctrl-1 = <0x04>;
			pinctrl-2 = <0x05>;
			pinctrl-3 = <0x06>;
			pinctrl-4 = <0x07>;
			pinctrl-5 = <0x08>;
			status = "okay";
		};
	};

	fragment@8 {
		target = <0xffffffff>;

		__overlay__ {

			eint0default {
				linux,phandle = <0x03>;
				phandle = <0x03>;
			};

			eint@0 {
				linux,phandle = <0x04>;
				phandle = <0x04>;

				pins_cmd_dat {
					pins = <0x100>;
					slew-rate = <0x00>;
					bias-disable;
				};
			};

			eintoutput0 {
				linux,phandle = <0x05>;
				phandle = <0x05>;

				pins_cmd_dat {
					pins = <0x100>;
					slew-rate = <0x01>;
					output-low;
				};
			};

			eintoutput1 {
				linux,phandle = <0x06>;
				phandle = <0x06>;

				pins_cmd_dat {
					pins = <0x100>;
					slew-rate = <0x01>;
					output-high;
				};
			};

			rstoutput0 {
				linux,phandle = <0x07>;
				phandle = <0x07>;

				pins_cmd_dat {
					pins = <0xf00>;
					slew-rate = <0x01>;
					output-low;
				};
			};

			rstoutput1 {
				linux,phandle = <0x08>;
				phandle = <0x08>;

				pins_cmd_dat {
					pins = <0xf00>;
					slew-rate = <0x01>;
					output-high;
				};
			};
		};
	};

	fragment@9 {
		target = <0xffffffff>;

		__overlay__ {
			i2c_num = <0x01>;
			direction = <0x05>;
			power_id = <0xffff>;
			power_vol = <0x00>;
			firlen = <0x10>;
			is_batch_supported = <0x01>;
		};
	};

	fragment@10 {
		target = <0xffffffff>;

		__overlay__ {

			alspspincfg {
				linux,phandle = <0x02>;
				phandle = <0x02>;

				pins_cmd_dat {
					pins = <0x600>;
					slew-rate = <0x00>;
					bias-pull-up = <0x00>;
				};
			};

			alspsdefaultcfg {
				linux,phandle = <0x01>;
				phandle = <0x01>;
			};
		};
	};

	fragment@11 {
		target = <0xffffffff>;

		__overlay__ {

			mode_te_gpio {
				linux,phandle = <0x0a>;
				phandle = <0x0a>;
			};

			mode_te_te {
				linux,phandle = <0x0b>;
				phandle = <0x0b>;
			};

			lcm_rst_out0_gpio {
				linux,phandle = <0x0c>;
				phandle = <0x0c>;

				pins_cmd_dat {
					pinmux = <0x2d00>;
					slew-rate = <0x01>;
					output-low;
				};
			};

			lcm_rst_out1_gpio {
				linux,phandle = <0x0d>;
				phandle = <0x0d>;

				pins_cmd_dat {
					pinmux = <0x2d00>;
					slew-rate = <0x01>;
					output-high;
				};
			};

			lcm_power_enp_en@0 {
				linux,phandle = <0x12>;
				phandle = <0x12>;
			};

			lcm_power_enp_en@1 {
				linux,phandle = <0x13>;
				phandle = <0x13>;
			};

			lcm_power_enn_en@0 {
				linux,phandle = <0x14>;
				phandle = <0x14>;
			};

			lcm_power_enn_en@1 {
				linux,phandle = <0x15>;
				phandle = <0x15>;
			};

			lcm_power_dm_en@0 {
				linux,phandle = <0x0e>;
				phandle = <0x0e>;
			};

			lcm_power_dm_en@1 {
				linux,phandle = <0x0f>;
				phandle = <0x0f>;
			};

			lcm_power_dp_en@0 {
				linux,phandle = <0x10>;
				phandle = <0x10>;
			};

			lcm_power_dp_en@1 {
				linux,phandle = <0x11>;
				phandle = <0x11>;
			};

			mtkfb_default {
				linux,phandle = <0x09>;
				phandle = <0x09>;
			};
		};
	};

	fragment@12 {
		target = <0xffffffff>;

		__overlay__ {
			pinctrl-names = "default\0mode_te_gpio\0mode_te_te\0lcm_rst_out0_gpio\0lcm_rst_out1_gpio\0lcm_power_dm_en0\0lcm_power_dm_en1\0lcm_power_dp_en0\0lcm_power_dp_en1\0lcm_power_enp_en0\0lcm_power_enp_en1\0lcm_power_enn_en0\0lcm_power_enn_en1";
			pinctrl-0 = <0x09>;
			pinctrl-1 = <0x0a>;
			pinctrl-2 = <0x0b>;
			pinctrl-3 = <0x0c>;
			pinctrl-4 = <0x0d>;
			pinctrl-5 = <0x0e>;
			pinctrl-6 = <0x0f>;
			pinctrl-7 = <0x10>;
			pinctrl-8 = <0x11>;
			pinctrl-9 = <0x12>;
			pinctrl-10 = <0x13>;
			pinctrl-11 = <0x14>;
			pinctrl-12 = <0x15>;
			status = "okay";
		};
	};

	fragment@13 {
		target = <0xffffffff>;

		__overlay__ {
			accdet-mic-vol = <0x06>;
			headset-mode-setting = <0x500 0x500 0x01 0x1f0 0x800 0x800 0x20 0x44>;
			accdet-plugout-debounce = <0x01>;
			accdet-mic-mode = <0x01>;
			headset-eint-level-pol = <0x08>;
			headset-three-key-threshold = <0x00 0x50 0xce 0x190>;
			headset-three-key-threshold-CDD = <0x00 0x79 0xc0 0x258>;
			headset-four-key-threshold = <0x00 0x3a 0x79 0xc0 0x190>;
			interrupt-parent = <0xffffffff>;
			interrupts = <0x09 0x02 0x09 0x00>;
			pinctrl-names = "default\0state_eint_as_int";
			pinctrl-0 = <0x16>;
			pinctrl-1 = <0x17>;
			status = "okay";
		};
	};

	fragment@14 {
		target = <0xffffffff>;

		__overlay__ {

			accdetdefault {
				linux,phandle = <0x16>;
				phandle = <0x16>;
			};

			accdeteint@0 {
				linux,phandle = <0x17>;
				phandle = <0x17>;

				pins_cmd_dat {
					pins = <0x900>;
					slew-rate = <0x00>;
					bias-disable;
				};
			};
		};
	};

	fragment@15 {
		target = <0xffffffff>;

		__overlay__ {

			consys_default {
				linux,phandle = <0x18>;
				phandle = <0x18>;
			};

			gpslna@0 {
				linux,phandle = <0x19>;
				phandle = <0x19>;

				pins_cmd_dat {
					pins = <0x6b00>;
					slew-rate = <0x00>;
					bias-disable;
					output-low;
				};
			};

			gpslna@1 {
				linux,phandle = <0x1a>;
				phandle = <0x1a>;

				pins_cmd_dat {
					pins = <0x6b00>;
					slew-rate = <0x01>;
					output-high;
				};
			};

			gpslna@2 {
				linux,phandle = <0x1b>;
				phandle = <0x1b>;

				pins_cmd_dat {
					pins = <0x6b00>;
					slew-rate = <0x01>;
					output-low;
				};
			};

			fmlna@0 {
				linux,phandle = <0x1c>;
				phandle = <0x1c>;

				pins_cmd_dat {
					pins = <0x1c00>;
					slew-rate = <0x00>;
					bias-disable;
					output-low;
				};
			};

			fmlna@1 {
				linux,phandle = <0x1d>;
				phandle = <0x1d>;

				pins_cmd_dat {
					pins = <0x1c00>;
					slew-rate = <0x01>;
					output-high;
				};
			};

			fmlna@2 {
				linux,phandle = <0x1e>;
				phandle = <0x1e>;

				pins_cmd_dat {
					pins = <0x1c00>;
					slew-rate = <0x01>;
					output-low;
				};
			};
		};
	};

	fragment@16 {
		target = <0xffffffff>;

		__overlay__ {
			pinctrl-names = "default\0gps_lna_state_init\0gps_lna_state_oh\0gps_lna_state_ol\0fm_lna_state_init\0fm_lna_state_oh\0fm_lna_state_ol";
			pinctrl-0 = <0x18>;
			pinctrl-1 = <0x19>;
			pinctrl-2 = <0x1a>;
			pinctrl-3 = <0x1b>;
			pinctrl-4 = <0x1c>;
			pinctrl-5 = <0x1d>;
			pinctrl-6 = <0x1e>;
			status = "okay";
		};
	};

	fragment@17 {
		target = <0xffffffff>;

		__overlay__ {

			camera_pins_cam0_mclk_on {
				linux,phandle = <0x36>;
				phandle = <0x36>;

				pins_cmd_dat {
					pins = <0x6301>;
				};
			};

			camera_pins_cam0_mclk_off {
				linux,phandle = <0x37>;
				phandle = <0x37>;

				pins_cmd_dat {
					pins = <0x6300>;
				};
			};

			camera_pins_cam1_mclk_on {
				linux,phandle = <0x38>;
				phandle = <0x38>;

				pins_cmd_dat {
					pins = <0x6401>;
				};
			};

			camera_pins_cam1_mclk_off {
				linux,phandle = <0x39>;
				phandle = <0x39>;

				pins_cmd_dat {
					pins = <0x6400>;
				};
			};

			camera_pins_cam2_mclk_on {
				linux,phandle = <0x3a>;
				phandle = <0x3a>;

				pins_cmd_dat {
					pins = <0x6401>;
				};
			};

			camera_pins_cam2_mclk_off {
				linux,phandle = <0x3b>;
				phandle = <0x3b>;

				pins_cmd_dat {
					pins = <0x6400>;
				};
			};

			cam0@0 {
				linux,phandle = <0x20>;
				phandle = <0x20>;

				pins_cmd_dat {
					pins = <0x6500>;
					slew-rate = <0x01>;
					output-low;
				};
			};

			cam0@1 {
				linux,phandle = <0x21>;
				phandle = <0x21>;

				pins_cmd_dat {
					pins = <0x6500>;
					slew-rate = <0x01>;
					output-high;
				};
			};

			cam0@2 {
				linux,phandle = <0x22>;
				phandle = <0x22>;

				pins_cmd_dat {
					pins = <0x6100>;
					slew-rate = <0x01>;
					output-low;
				};
			};

			cam0@3 {
				linux,phandle = <0x23>;
				phandle = <0x23>;

				pins_cmd_dat {
					pins = <0x6100>;
					slew-rate = <0x01>;
					output-high;
				};
			};

			cam1@0 {
				linux,phandle = <0x24>;
				phandle = <0x24>;

				pins_cmd_dat {
					pins = <0x6600>;
					slew-rate = <0x01>;
					output-low;
				};
			};

			cam1@1 {
				linux,phandle = <0x25>;
				phandle = <0x25>;

				pins_cmd_dat {
					pins = <0x6600>;
					slew-rate = <0x01>;
					output-high;
				};
			};

			cam1@2 {
				linux,phandle = <0x26>;
				phandle = <0x26>;

				pins_cmd_dat {
					pins = <0x6200>;
					slew-rate = <0x01>;
					output-low;
				};
			};

			cam1@3 {
				linux,phandle = <0x27>;
				phandle = <0x27>;

				pins_cmd_dat {
					pins = <0x6200>;
					slew-rate = <0x01>;
					output-high;
				};
			};

			cam2@0 {
				linux,phandle = <0x28>;
				phandle = <0x28>;

				pins_cmd_dat {
					pins = <0x4e00>;
					slew-rate = <0x01>;
					output-low;
				};
			};

			cam2@1 {
				linux,phandle = <0x29>;
				phandle = <0x29>;

				pins_cmd_dat {
					pins = <0x4e00>;
					slew-rate = <0x01>;
					output-high;
				};
			};

			cam2@3 {
				linux,phandle = <0x2a>;
				phandle = <0x2a>;

				pins_cmd_dat {
					pins = <0x3600>;
					slew-rate = <0x01>;
					output-low;
				};
			};

			cam2@4 {
				linux,phandle = <0x2b>;
				phandle = <0x2b>;

				pins_cmd_dat {
					pins = <0x3600>;
					slew-rate = <0x01>;
					output-high;
				};
			};

			cam0@vcamd0 {
				linux,phandle = <0x2d>;
				phandle = <0x2d>;

				pins_cmd_dat {
					pins = <0x1500>;
					slew-rate = <0x01>;
					output-low;
				};
			};

			cam0@vcamd1 {
				linux,phandle = <0x2c>;
				phandle = <0x2c>;

				pins_cmd_dat {
					pins = <0x1500>;
					slew-rate = <0x01>;
					output-high;
				};
			};

			cam0@vcama0 {
				linux,phandle = <0x2f>;
				phandle = <0x2f>;

				pins_cmd_dat {
					pins = <0x1400>;
					slew-rate = <0x01>;
					output-low;
				};
			};

			cam0@vcama1 {
				linux,phandle = <0x2e>;
				phandle = <0x2e>;

				pins_cmd_dat {
					pins = <0x1400>;
					slew-rate = <0x01>;
					output-high;
				};
			};

			cam1@vcamd0 {
				linux,phandle = <0x31>;
				phandle = <0x31>;

				pins_cmd_dat {
					pins = <0x4f00>;
					slew-rate = <0x01>;
					output-low;
				};
			};

			cam1@vcamd1 {
				linux,phandle = <0x30>;
				phandle = <0x30>;

				pins_cmd_dat {
					pins = <0x4f00>;
					slew-rate = <0x01>;
					output-high;
				};
			};

			cam1@vcama0 {
				linux,phandle = <0x33>;
				phandle = <0x33>;

				pins_cmd_dat {
					pins = <0x4f00>;
					slew-rate = <0x01>;
					output-low;
				};
			};

			cam1@vcama1 {
				linux,phandle = <0x32>;
				phandle = <0x32>;

				pins_cmd_dat {
					pins = <0x4f00>;
					slew-rate = <0x01>;
					output-high;
				};
			};

			cam2@vcama0 {
				linux,phandle = <0x35>;
				phandle = <0x35>;

				pins_cmd_dat {
					pins = <0x5e00>;
					slew-rate = <0x01>;
					output-low;
				};
			};

			cam2@vcama1 {
				linux,phandle = <0x34>;
				phandle = <0x34>;

				pins_cmd_dat {
					pins = <0x5e00>;
					slew-rate = <0x01>;
					output-high;
				};
			};

			cam0@af0 {
				linux,phandle = <0x3d>;
				phandle = <0x3d>;

				pins_cmd_dat {
					pins = <0x1800>;
					slew-rate = <0x01>;
					output-low;
				};
			};

			cam0@af1 {
				linux,phandle = <0x3c>;
				phandle = <0x3c>;

				pins_cmd_dat {
					pins = <0x1800>;
					slew-rate = <0x01>;
					output-high;
				};
			};

			camdefault {
				linux,phandle = <0x1f>;
				phandle = <0x1f>;
			};
		};
	};

	fragment@18 {
		target = <0xffffffff>;

		__overlay__ {
			pinctrl-names = "default\0cam0_rst0\0cam0_rst1\0cam0_pnd0\0cam0_pnd1\0cam1_rst0\0cam1_rst1\0cam1_pnd0\0cam1_pnd1\0cam2_rst0\0cam2_rst1\0cam2_pnd0\0cam2_pnd1\0cam0_vcamd_on\0cam0_vcamd_off\0cam0_vcama_on\0cam0_vcama_off\0cam1_vcamd_on\0cam1_vcamd_off\0cam1_vcama_on\0cam1_vcama_off\0cam2_vcama_on\0cam2_vcama_off\0cam0_mclk_on\0cam0_mclk_off\0cam1_mclk_on\0cam1_mclk_off\0cam2_mclk_on\0cam2_mclk_off\0af_en_h\0af_en_l";
			pinctrl-0 = <0x1f>;
			pinctrl-1 = <0x20>;
			pinctrl-2 = <0x21>;
			pinctrl-3 = <0x22>;
			pinctrl-4 = <0x23>;
			pinctrl-5 = <0x24>;
			pinctrl-6 = <0x25>;
			pinctrl-7 = <0x26>;
			pinctrl-8 = <0x27>;
			pinctrl-9 = <0x28>;
			pinctrl-10 = <0x29>;
			pinctrl-11 = <0x2a>;
			pinctrl-12 = <0x2b>;
			pinctrl-13 = <0x2c>;
			pinctrl-14 = <0x2d>;
			pinctrl-15 = <0x2e>;
			pinctrl-16 = <0x2f>;
			pinctrl-17 = <0x30>;
			pinctrl-18 = <0x31>;
			pinctrl-19 = <0x32>;
			pinctrl-20 = <0x33>;
			pinctrl-21 = <0x34>;
			pinctrl-22 = <0x35>;
			pinctrl-23 = <0x36>;
			pinctrl-24 = <0x37>;
			pinctrl-25 = <0x38>;
			pinctrl-26 = <0x39>;
			pinctrl-27 = <0x3a>;
			pinctrl-28 = <0x3b>;
			pinctrl-29 = <0x3c>;
			pinctrl-30 = <0x3d>;
			status = "okay";
		};
	};

	fragment@19 {
		target = <0xffffffff>;

		__overlay__ {
			#address-cells = <0x01>;
			#size-cells = <0x00>;

			fingerprint@spi0 {
				compatible = "focaltech,fingerprint-spidev";
				reg = <0x00>;
				spi-max-frequency = <0xf4240>;
				status = "okay";
				linux,phandle = <0x60>;
				phandle = <0x60>;
			};
		};
	};

	fragment@20 {
		target = <0xffffffff>;

		__overlay__ {
			interrupt-parent = <0xffffffff>;
			interrupts = <0x08 0x02 0x08 0x00>;
			pinctrl-names = "default\0fpc_eint_as_int\0fpc_pins_rst_high\0fpc_pins_rst_low\0fpc_pins_pwr_high\0fpc_pins_pwr_low\0fpc_mode_as_cs\0fpc_mode_as_ck\0fpc_mode_as_mi\0fpc_mode_as_mo";
			pinctrl-0 = <0x3e>;
			pinctrl-1 = <0x3f>;
			pinctrl-2 = <0x40>;
			pinctrl-3 = <0x41>;
			pinctrl-4 = <0x42>;
			pinctrl-5 = <0x43>;
			pinctrl-6 = <0x44>;
			pinctrl-7 = <0x45>;
			pinctrl-8 = <0x46>;
			pinctrl-9 = <0x47>;
			status = "okay";
		};
	};

	fragment@21 {
		target = <0xffffffff>;

		__overlay__ {

			fpcdefault {
				linux,phandle = <0x3e>;
				phandle = <0x3e>;
			};

			fpceint@0 {
				linux,phandle = <0x3f>;
				phandle = <0x3f>;

				pins_cmd_dat {
					pinmux = <0x800>;
					slew-rate = <0x00>;
					bias-disable;
				};
			};

			fpcrsthigh {
				linux,phandle = <0x40>;
				phandle = <0x40>;

				pins_cmd_dat {
					pinmux = <0x1200>;
					slew-rate = <0x01>;
					output-high;
				};
			};

			fpcrstlow {
				linux,phandle = <0x41>;
				phandle = <0x41>;

				pins_cmd_dat {
					pinmux = <0x1200>;
					slew-rate = <0x01>;
					output-low;
				};
			};

			fpcpwrhigh {
				linux,phandle = <0x42>;
				phandle = <0x42>;

				pins_cmd_dat {
					pinmux = <0x5000>;
					slew-rate = <0x01>;
					output-high;
				};
			};

			fpcpwrlow {
				linux,phandle = <0x43>;
				phandle = <0x43>;

				pins_cmd_dat {
					pinmux = <0x5000>;
					slew-rate = <0x01>;
					output-low;
				};
			};

			fpccs {
				linux,phandle = <0x44>;
				phandle = <0x44>;

				pins_cmd_dat {
					pinmux = <0x5601>;
					bias-pull-up = <0x00>;
				};
			};

			fpcck {
				linux,phandle = <0x45>;
				phandle = <0x45>;

				pins_cmd_dat {
					pinmux = <0x5801>;
					bias-pull-up = <0x00>;
				};
			};

			fpcmi {
				linux,phandle = <0x46>;
				phandle = <0x46>;

				pins_cmd_dat {
					pinmux = <0x5501>;
					bias-pull-up = <0x00>;
				};
			};

			fpcmo {
				linux,phandle = <0x47>;
				phandle = <0x47>;

				pins_cmd_dat {
					pinmux = <0x5701>;
					bias-pull-down = <0x00>;
				};
			};
		};
	};

	fragment@22 {
		target = <0xffffffff>;

		__overlay__ {
			pinctrl-names = "uart0_gpio_default\0uart0_rx_set\0uart0_rx_clear\0uart0_tx_set\0uart0_tx_clear";
			pinctrl-0 = <0x48>;
			pinctrl-1 = <0x49>;
			pinctrl-2 = <0x4a>;
			pinctrl-3 = <0x4b>;
			pinctrl-4 = <0x4c>;
			status = "okay";
		};
	};

	fragment@23 {
		target = <0xffffffff>;

		__overlay__ {

			uart0gpiodefault {
				linux,phandle = <0x48>;
				phandle = <0x48>;
			};

			uart0_rx_set@gpio95 {
				linux,phandle = <0x49>;
				phandle = <0x49>;

				pins_cmd_dat {
					pins = <0x5f01>;
				};
			};

			uart0_rx_clear@gpio95 {
				linux,phandle = <0x4a>;
				phandle = <0x4a>;

				pins_cmd_dat {
					pins = <0x5f00>;
					slew-rate = <0x01>;
					output-high;
				};
			};

			uart0_tx_set@gpio96 {
				linux,phandle = <0x4b>;
				phandle = <0x4b>;

				pins_cmd_dat {
					pins = <0x6001>;
				};
			};

			uart0_tx_clear@gpio96 {
				linux,phandle = <0x4c>;
				phandle = <0x4c>;

				pins_cmd_dat {
					pins = <0x6000>;
					slew-rate = <0x01>;
					output-high;
				};
			};
		};
	};

	fragment@24 {
		target = <0xffffffff>;

		__overlay__ {
			pinctrl-names = "irtx_gpio_led_default\0irtx_gpio_led_set";
			pinctrl-0 = <0x4d>;
			pinctrl-1 = <0x4e>;
			status = "okay";
		};
	};

	fragment@25 {
		target = <0xffffffff>;

		__overlay__ {

			irtx_gpio_led_def@gpio58 {
				linux,phandle = <0x4d>;
				phandle = <0x4d>;

				pins_cmd_dat {
					pins = <0x3a00>;
					slew-rate = <0x01>;
					bias-disable;
					output-low;
					input-schmitt-enable = <0x00>;
				};
			};

			irtx_gpio_led_set@gpio58 {
				linux,phandle = <0x4e>;
				phandle = <0x4e>;

				pins_cmd_dat {
					pins = <0x3a03>;
					slew-rate = <0x01>;
					output-high;
				};
			};
		};
	};

	fragment@26 {
		target = <0xffffffff>;

		__overlay__ {
			pinctrl-names = "aud_dat_mosi_off\0aud_dat_mosi_on\0aud_dat_miso_off\0aud_dat_miso_on\0extamp-pullhigh\0extamp-pulllow";
			pinctrl-0 = <0x4f>;
			pinctrl-1 = <0x50>;
			pinctrl-2 = <0x51>;
			pinctrl-3 = <0x52>;
			pinctrl-4 = <0x53>;
			pinctrl-5 = <0x54>;
			status = "okay";
		};
	};

	fragment@27 {
		target = <0xffffffff>;

		__overlay__ {

			aud_dat_mosi_off {
				linux,phandle = <0x4f>;
				phandle = <0x4f>;

				pins_cmd1_dat {
					pins = <0x8a00>;
					input-enable;
					slew-rate = <0x00>;
					bias-disable;
				};

				pins_cmd2_dat {
					pins = <0x8b00>;
					input-enable;
					slew-rate = <0x00>;
					bias-disable;
				};
			};

			aud_dat_mosi_on {
				linux,phandle = <0x50>;
				phandle = <0x50>;

				pins_cmd1_dat {
					pins = <0x8a01>;
				};

				pins_cmd2_dat {
					pins = <0x8b01>;
				};
			};

			aud_dat_miso_off {
				linux,phandle = <0x51>;
				phandle = <0x51>;

				pins_cmd1_dat {
					pins = <0x8e00>;
					input-enable;
					slew-rate = <0x00>;
					bias-disable;
				};

				pins_cmd2_dat {
					pins = <0x8f00>;
					input-enable;
					slew-rate = <0x00>;
					bias-disable;
				};
			};

			aud_dat_miso_on {
				linux,phandle = <0x52>;
				phandle = <0x52>;

				pins_cmd1_dat {
					pins = <0x8e01>;
				};

				pins_cmd2_dat {
					pins = <0x8f01>;
				};
			};

			aud_pins_extamp_pullhigh {
				linux,phandle = <0x53>;
				phandle = <0x53>;

				pins_cmd_dat {
					pins = <0x1300>;
					slew-rate = <0x01>;
					output-high;
				};
			};

			aud_pins_extamp_pulllow {
				linux,phandle = <0x54>;
				phandle = <0x54>;

				pins_cmd_dat {
					pins = <0x1300>;
					slew-rate = <0x01>;
					output-low;
				};
			};
		};
	};

	fragment@28 {
		target = <0xffffffff>;

		__overlay__ {
			mt6370,intr_gpio_num = <0x5b>;
			mt6370,intr_gpio = <0xffffffff 0x5b 0x00>;

			charger {
				cv = <0x42d560>;
				pinctrl-names = "default\0charger_otg_off\0charger_otg_on";
				pinctrl-0 = <0x55>;
				pinctrl-1 = <0x56>;
				pinctrl-2 = <0x57>;
				status = "okay";
			};
		};
	};

	fragment@29 {
		target = <0xffffffff>;

		__overlay__ {

			charger_otg_default {
				linux,phandle = <0x55>;
				phandle = <0x55>;
			};

			charger_otg_en@0 {
				linux,phandle = <0x56>;
				phandle = <0x56>;

				pins_cmd_dat {
					pins = <0xe00>;
					slew-rate = <0x01>;
					output-low;
				};
			};

			charger_otg_en@1 {
				linux,phandle = <0x57>;
				phandle = <0x57>;

				pins_cmd_dat {
					pins = <0xe00>;
					slew-rate = <0x01>;
					output-high;
				};
			};
		};
	};

	fragment@30 {
		target = <0xffffffff>;

		__overlay__ {
			algorithm_name = "DualSwitchCharging";
			chg1_ta_ac_charger_current = <0x124f80>;
			chg2_ta_ac_charger_current = <0x124f80>;
		};
	};

	fragment@31 {
		target = <0xffffffff>;

		__overlay__ {
			mt6370pd,intr_gpio_num = <0x29>;
			mt6370pd,intr_gpio = <0xffffffff 0x29 0x00>;
		};
	};

	fragment@32 {
		target = <0xffffffff>;

		__overlay__ {
			gpio-rst = <0x19>;
			gpio-rst-std = <0xffffffff 0x19 0x00>;
			gpio-irq = <0x00>;
			gpio-irq-std = <0xffffffff 0x00 0x00>;
		};
	};

	fragment@33 {
		target = <0xffffffff>;

		__overlay__ {
			partial-update = <0x01>;
			status = "okay";
		};
	};

	fragment@34 {
		target = <0xffffffff>;

		__overlay__ {

			MT5715_receiver@56 {
				compatible = "MT5715_receiver";
				reg = <0x56>;
				irq-gpio = <0xffffffff 0x0a 0x00>;
				dc-gpio = <0xffffffff 0x16 0x00>;
				status = "okay";
			};
		};
	};

	fragment@35 {
		target = <0xffffffff>;

		__overlay__ {

			spc@40 {
				compatible = "prize,dcam_r";
				reg = <0x3c>;
				pdn_pin = <0xffffffff 0x36 0x00>;
				rst_pin = <0xffffffff 0x4e 0x00>;
				sensor_type = <0x17f5>;
			};
		};
	};

	fragment@36 {
		target = <0xffffffff>;

		__overlay__ {

			adc_channel@ {
				compatible = "mediatek,adc_channel";
				mediatek,temperature0 = <0x00>;
				mediatek,temperature1 = <0x01>;
				mediatek,adc_fdd_rf_params_dynamic_custom_ch = <0x02>;
				mediatek,board_id = <0x03>;
				mediatek,board_id_2 = <0x04>;
				status = "okay";
			};
		};
	};

	fragment@37 {
		target = <0xffffffff>;

		__overlay__ {
			mediatek,clkbuf-quantity = <0x07>;
			mediatek,clkbuf-config = <0x02 0x01 0x01 0x02 0x00 0x00 0x01>;
			mediatek,clkbuf-driving-current = <0xffffffff 0xffffffff 0xffffffff 0xffffffff 0xffffffff 0xffffffff 0xffffffff>;
			status = "okay";
		};
	};

	fragment@38 {
		target = <0xffffffff>;

		__overlay__ {
			#address-cells = <0x01>;
			#size-cells = <0x00>;
			clock-frequency = <0x61a80>;
			mediatek,use-open-drain;

			cap_touch@5d {
				compatible = "mediatek,cap_touch";
				reg = <0x5d>;
				status = "okay";
				linux,phandle = <0x61>;
				phandle = <0x61>;
			};
		};
	};

	fragment@39 {
		target = <0xffffffff>;

		__overlay__ {
			#address-cells = <0x01>;
			#size-cells = <0x00>;
			clock-frequency = <0x61a80>;
			mediatek,use-open-drain;

			msensor@0c {
				compatible = "mediatek,msensor";
				reg = <0x0c>;
				status = "okay";
				linux,phandle = <0x62>;
				phandle = <0x62>;
			};

			gsensor@69 {
				compatible = "mediatek,gsensor";
				reg = <0x69>;
				status = "okay";
				linux,phandle = <0x63>;
				phandle = <0x63>;
			};

			barometer@77 {
				compatible = "mediatek,barometer";
				reg = <0x77>;
				status = "okay";
				linux,phandle = <0x64>;
				phandle = <0x64>;
			};

			speaker_amp@34 {
				compatible = "mediatek,speaker_amp";
				reg = <0x34>;
				status = "okay";
				linux,phandle = <0x65>;
				phandle = <0x65>;
			};

			ext_buck_lp4@57 {
				compatible = "mediatek,ext_buck_lp4";
				reg = <0x57>;
				status = "okay";
				linux,phandle = <0x66>;
				phandle = <0x66>;
			};

			ext_buck_lp4x@50 {
				compatible = "mediatek,ext_buck_lp4x";
				reg = <0x50>;
				status = "okay";
				linux,phandle = <0x67>;
				phandle = <0x67>;
			};

			gyro@66 {
				compatible = "mediatek,gyro";
				reg = <0x66>;
				status = "okay";
				linux,phandle = <0x68>;
				phandle = <0x68>;
			};
		};
	};

	fragment@40 {
		target = <0xffffffff>;

		__overlay__ {
			#address-cells = <0x01>;
			#size-cells = <0x00>;
			clock-frequency = <0x61a80>;
			mediatek,use-open-drain;

			camera_main@1a {
				compatible = "mediatek,camera_main";
				reg = <0x1a>;
				status = "okay";
				linux,phandle = <0x69>;
				phandle = <0x69>;
			};

			camera_main_af@0c {
				compatible = "mediatek,camera_main_af";
				reg = <0x0c>;
				status = "okay";
				linux,phandle = <0x6a>;
				phandle = <0x6a>;
			};

			camera_main_eeprom@1b {
				compatible = "mediatek,camera_main_eeprom";
				reg = <0x1b>;
				status = "okay";
				linux,phandle = <0x6b>;
				phandle = <0x6b>;
			};
		};
	};

	fragment@41 {
		target = <0xffffffff>;

		__overlay__ {
			#address-cells = <0x01>;
			#size-cells = <0x00>;
			clock-frequency = <0x61a80>;
			mediatek,use-open-drain;

			alsps@67 {
				compatible = "mediatek,alsps";
				reg = <0x67>;
				status = "okay";
				interrupt-parent = <0xffffffff>;
				interrupts = <0x06 0x08>;
				debounce = <0x06 0x00>;
				linux,phandle = <0x6c>;
				phandle = <0x6c>;
			};

			nfc@08 {
				compatible = "mediatek,nfc";
				reg = <0x08>;
				status = "okay";
				linux,phandle = <0x6d>;
				phandle = <0x6d>;
			};
		};
	};

	fragment@42 {
		target = <0xffffffff>;

		__overlay__ {
			#address-cells = <0x01>;
			#size-cells = <0x00>;
			clock-frequency = <0x61a80>;
			mediatek,use-open-drain;

			camera_sub@10 {
				compatible = "mediatek,camera_sub";
				reg = <0x10>;
				status = "okay";
				linux,phandle = <0x6e>;
				phandle = <0x6e>;
			};

			camera_sub_af@0c {
				compatible = "mediatek,camera_sub_af";
				reg = <0x0c>;
				status = "okay";
				linux,phandle = <0x6f>;
				phandle = <0x6f>;
			};

			camera_sub_eeprom@1c {
				compatible = "mediatek,camera_sub_eeprom";
				reg = <0x1c>;
				status = "okay";
				linux,phandle = <0x70>;
				phandle = <0x70>;
			};

			camera_main_two_eeprom@54 {
				compatible = "mediatek,camera_main_two_eeprom";
				reg = <0x54>;
				status = "okay";
				linux,phandle = <0x71>;
				phandle = <0x71>;
			};
		};
	};

	fragment@43 {
		target = <0xffffffff>;

		__overlay__ {
			#address-cells = <0x01>;
			#size-cells = <0x00>;
			clock-frequency = <0x33e140>;
			mediatek,use-push-pull;

			mt6370_pmu@34 {
				compatible = "mediatek,mt6370_pmu";
				reg = <0x34>;
				status = "okay";
				linux,phandle = <0x72>;
				phandle = <0x72>;
			};

			usb_type_c@4e {
				compatible = "mediatek,usb_type_c";
				reg = <0x4e>;
				status = "okay";
				linux,phandle = <0x73>;
				phandle = <0x73>;
			};
		};
	};

	fragment@44 {
		target = <0xffffffff>;

		__overlay__ {
			#address-cells = <0x01>;
			#size-cells = <0x00>;
			clock-frequency = <0x33e140>;
			mediatek,use-push-pull;

			vgpu_buck@6b {
				compatible = "mediatek,vgpu_buck";
				reg = <0x6b>;
				status = "okay";
				linux,phandle = <0x74>;
				phandle = <0x74>;
			};
		};
	};

	fragment@45 {
		target = <0xffffffff>;

		__overlay__ {
			#address-cells = <0x01>;
			#size-cells = <0x00>;
			clock-frequency = <0x61a80>;
			mediatek,use-open-drain;
		};
	};

	fragment@46 {
		target = <0xffffffff>;

		__overlay__ {
			#address-cells = <0x01>;
			#size-cells = <0x00>;
			clock-frequency = <0x61a80>;
			mediatek,use-open-drain;

			ccu_sensor_i2c_main_hw@33 {
				compatible = "mediatek,ccu_sensor_i2c_main_hw";
				reg = <0x33>;
				status = "okay";
				linux,phandle = <0x75>;
				phandle = <0x75>;
			};
		};
	};

	fragment@47 {
		target = <0xffffffff>;

		__overlay__ {
			#address-cells = <0x01>;
			#size-cells = <0x00>;
			clock-frequency = <0x61a80>;
			mediatek,use-open-drain;

			ccu_sensor_i2c_sub_hw@43 {
				compatible = "mediatek,ccu_sensor_i2c_sub_hw";
				reg = <0x43>;
				status = "okay";
				linux,phandle = <0x76>;
				phandle = <0x76>;
			};
		};
	};

	fragment@48 {
		target = <0xffffffff>;

		__overlay__ {
			GPIO_SIM2_SIO = <0xffffffff 0x23 0x00>;
			GPIO_SIM2_SRST = <0xffffffff 0x24 0x00>;
			GPIO_SIM2_SCLK = <0xffffffff 0x25 0x00>;
			GPIO_SIM1_SCLK = <0xffffffff 0x26 0x00>;
			GPIO_SIM1_SRST = <0xffffffff 0x27 0x00>;
			GPIO_SIM1_SIO = <0xffffffff 0x28 0x00>;
			GPIO_SIM1_HOT_PLUG = <0xffffffff 0x2f 0x00>;
		};
	};

	fragment@49 {
		target = <0xffffffff>;

		__overlay__ {
			gpio_init_default = <0x00 0x00 0x00 0x00 0x01 0x00 0x01 0x01 0x00 0x00 0x00 0x01 0x01 0x01 0x02 0x00 0x00 0x00 0x01 0x00 0x01 0x03 0x00 0x00 0x00 0x01 0x01 0x01 0x04 0x00 0x00 0x00 0x01 0x00 0x00 0x05 0x00 0x00 0x00 0x01 0x01 0x00 0x06 0x00 0x00 0x00 0x01 0x01 0x00 0x07 0x02 0x00 0x00 0x01 0x00 0x00 0x08 0x00 0x00 0x00 0x01 0x00 0x00 0x09 0x00 0x00 0x00 0x01 0x01 0x00 0x0a 0x00 0x01 0x00 0x00 0x00 0x00 0x0b 0x03 0x00 0x00 0x01 0x01 0x00 0x0c 0x03 0x00 0x00 0x01 0x01 0x00 0x0d 0x04 0x00 0x00 0x01 0x01 0x00 0x0e 0x00 0x01 0x00 0x00 0x00 0x00 0x0f 0x04 0x00 0x00 0x01 0x00 0x00 0x10 0x04 0x01 0x01 0x00 0x01 0x00 0x11 0x00 0x01 0x00 0x00 0x00 0x00 0x12 0x00 0x01 0x00 0x00 0x00 0x00 0x13 0x00 0x01 0x00 0x00 0x00 0x00 0x14 0x06 0x01 0x00 0x00 0x00 0x00 0x15 0x00 0x01 0x01 0x00 0x00 0x00 0x16 0x00 0x00 0x00 0x01 0x00 0x00 0x17 0x00 0x01 0x00 0x00 0x00 0x00 0x18 0x00 0x01 0x00 0x01 0x00 0x00 0x19 0x00 0x01 0x00 0x01 0x00 0x00 0x1a 0x00 0x01 0x00 0x00 0x00 0x00 0x1b 0x00 0x01 0x00 0x01 0x00 0x00 0x1c 0x00 0x01 0x00 0x01 0x00 0x00 0x1d 0x01 0x01 0x00 0x01 0x00 0x00 0x1e 0x01 0x00 0x00 0x01 0x01 0x00 0x1f 0x01 0x00 0x00 0x01 0x01 0x00 0x20 0x01 0x00 0x00 0x01 0x01 0x00 0x21 0x01 0x00 0x00 0x01 0x01 0x00 0x22 0x01 0x00 0x00 0x01 0x01 0x00 0x23 0x01 0x00 0x00 0x01 0x01 0x00 0x24 0x01 0x01 0x00 0x01 0x00 0x00 0x25 0x01 0x01 0x00 0x01 0x00 0x00 0x26 0x01 0x01 0x00 0x01 0x00 0x00 0x27 0x01 0x01 0x00 0x01 0x00 0x00 0x28 0x01 0x00 0x00 0x01 0x01 0x00 0x29 0x00 0x00 0x00 0x01 0x01 0x00 0x2a 0x01 0x01 0x00 0x01 0x00 0x00 0x2b 0x01 0x01 0x00 0x01 0x00 0x00 0x2c 0x01 0x00 0x00 0x01 0x00 0x00 0x2d 0x01 0x01 0x00 0x00 0x00 0x00 0x2e 0x00 0x00 0x00 0x01 0x00 0x00 0x2f 0x01 0x00 0x00 0x01 0x01 0x00 0x30 0x01 0x00 0x00 0x01 0x01 0x00 0x31 0x01 0x00 0x00 0x01 0x01 0x00 0x32 0x01 0x00 0x00 0x01 0x01 0x00 0x33 0x01 0x00 0x00 0x01 0x01 0x00 0x34 0x01 0x01 0x00 0x01 0x00 0x00 0x35 0x01 0x01 0x00 0x01 0x00 0x00 0x36 0x01 0x01 0x00 0x01 0x00 0x00 0x37 0x01 0x01 0x00 0x01 0x00 0x00 0x38 0x01 0x01 0x00 0x01 0x00 0x00 0x39 0x01 0x01 0x00 0x01 0x00 0x00 0x3a 0x01 0x01 0x00 0x00 0x00 0x00 0x3b 0x01 0x01 0x00 0x01 0x00 0x00 0x3c 0x01 0x01 0x00 0x01 0x00 0x00 0x3d 0x01 0x00 0x00 0x01 0x00 0x00 0x3e 0x01 0x00 0x00 0x01 0x00 0x00 0x3f 0x01 0x00 0x00 0x01 0x00 0x00 0x40 0x01 0x00 0x00 0x01 0x00 0x00 0x41 0x02 0x00 0x00 0x01 0x00 0x00 0x42 0x02 0x00 0x00 0x01 0x00 0x00 0x43 0x01 0x00 0x00 0x01 0x00 0x00 0x44 0x01 0x00 0x00 0x01 0x00 0x00 0x45 0x01 0x01 0x00 0x01 0x00 0x00 0x46 0x01 0x01 0x00 0x01 0x00 0x00 0x47 0x01 0x00 0x00 0x01 0x00 0x00 0x48 0x01 0x00 0x00 0x01 0x00 0x00 0x49 0x01 0x01 0x00 0x01 0x00 0x00 0x4a 0x01 0x01 0x00 0x01 0x00 0x00 0x4b 0x01 0x01 0x00 0x01 0x00 0x00 0x4c 0x01 0x01 0x00 0x01 0x00 0x00 0x4d 0x01 0x01 0x00 0x01 0x00 0x00 0x4e 0x00 0x01 0x01 0x00 0x00 0x00 0x4f 0x00 0x01 0x00 0x00 0x00 0x00 0x50 0x00 0x01 0x00 0x01 0x00 0x00 0x51 0x01 0x00 0x00 0x01 0x01 0x00 0x52 0x01 0x00 0x00 0x01 0x01 0x00 0x53 0x01 0x00 0x00 0x01 0x01 0x00 0x54 0x01 0x00 0x00 0x01 0x01 0x00 0x55 0x01 0x01 0x00 0x01 0x00 0x00 0x56 0x01 0x00 0x00 0x01 0x00 0x00 0x57 0x01 0x00 0x00 0x01 0x00 0x00 0x58 0x01 0x01 0x00 0x01 0x00 0x00 0x59 0x01 0x00 0x00 0x01 0x00 0x00 0x5a 0x00 0x01 0x00 0x00 0x00 0x00 0x5b 0x00 0x00 0x00 0x01 0x01 0x00 0x5c 0x01 0x01 0x00 0x00 0x00 0x00 0x5d 0x01 0x00 0x00 0x01 0x01 0x00 0x5e 0x01 0x00 0x00 0x01 0x01 0x00 0x5f 0x01 0x00 0x00 0x01 0x01 0x00 0x60 0x01 0x01 0x01 0x00 0x00 0x00 0x61 0x00 0x01 0x00 0x00 0x00 0x00 0x62 0x00 0x01 0x00 0x00 0x00 0x00 0x63 0x01 0x01 0x00 0x00 0x00 0x00 0x64 0x01 0x01 0x00 0x00 0x00 0x00 0x65 0x00 0x01 0x00 0x00 0x00 0x00 0x66 0x00 0x01 0x00 0x00 0x00 0x00 0x67 0x01 0x00 0x00 0x01 0x01 0x00 0x68 0x01 0x00 0x00 0x01 0x01 0x00 0x69 0x01 0x00 0x00 0x01 0x01 0x00 0x6a 0x01 0x00 0x00 0x01 0x01 0x00 0x6b 0x00 0x01 0x00 0x00 0x00 0x00 0x6c 0x00 0x01 0x01 0x00 0x00 0x00 0x6d 0x00 0x01 0x00 0x00 0x00 0x00 0x6e 0x01 0x00 0x00 0x01 0x00 0x00 0x6f 0x01 0x00 0x00 0x01 0x00 0x00 0x70 0x01 0x00 0x01 0x01 0x00 0x00 0x71 0x01 0x00 0x00 0x01 0x00 0x00 0x72 0x01 0x00 0x00 0x01 0x00 0x00 0x73 0x01 0x00 0x00 0x01 0x00 0x00 0x74 0x01 0x00 0x00 0x01 0x00 0x00 0x75 0x01 0x00 0x00 0x01 0x00 0x00 0x76 0x01 0x00 0x00 0x01 0x00 0x00 0x77 0x01 0x00 0x00 0x01 0x00 0x00 0x78 0x01 0x00 0x00 0x01 0x00 0x00 0x79 0x01 0x00 0x00 0x01 0x00 0x00 0x7a 0x00 0x00 0x00 0x01 0x00 0x00 0x7b 0x00 0x00 0x00 0x01 0x00 0x00 0x7c 0x00 0x00 0x00 0x01 0x00 0x00 0x7d 0x00 0x00 0x00 0x01 0x00 0x00 0x7e 0x00 0x00 0x00 0x01 0x00 0x00 0x7f 0x00 0x00 0x00 0x01 0x00 0x00 0x80 0x00 0x00 0x00 0x01 0x00 0x00 0x81 0x00 0x00 0x00 0x01 0x00 0x00 0x82 0x00 0x00 0x00 0x01 0x00 0x00 0x83 0x00 0x01 0x00 0x00 0x00 0x00 0x84 0x00 0x00 0x00 0x01 0x00 0x00 0x85 0x00 0x00 0x00 0x01 0x00 0x00 0x86 0x01 0x00 0x00 0x00 0x00 0x01 0x87 0x01 0x01 0x00 0x00 0x00 0x00 0x88 0x01 0x00 0x00 0x00 0x00 0x00 0x89 0x01 0x00 0x00 0x00 0x00 0x00 0x8a 0x01 0x00 0x00 0x00 0x00 0x00 0x8b 0x01 0x00 0x00 0x00 0x00 0x00 0x8c 0x01 0x00 0x00 0x00 0x00 0x00 0x8d 0x01 0x00 0x00 0x00 0x00 0x00 0x8e 0x01 0x00 0x00 0x00 0x00 0x00 0x8f 0x01 0x00 0x00 0x00 0x00 0x00 0x90 0x01 0x00 0x00 0x00 0x00 0x00 0x91 0x01 0x01 0x01 0x00 0x00 0x00 0x92 0x01 0x00 0x00 0x00 0x00 0x00 0x93 0x01 0x00 0x00 0x00 0x00 0x00 0x94 0x01 0x01 0x01 0x00 0x00 0x00 0x95 0x01 0x01 0x00 0x00 0x00 0x00 0x96 0x01 0x01 0x00 0x01 0x00 0x00 0x97 0x01 0x01 0x00 0x01 0x00 0x00 0x98 0x00 0x00 0x00 0x01 0x00 0x00 0x99 0x00 0x00 0x00 0x01 0x00 0x00 0x9a 0x00 0x00 0x00 0x01 0x00 0x00 0x9b 0x00 0x00 0x00 0x01 0x00 0x00 0x9c 0x00 0x00 0x00 0x01 0x00 0x00 0x9d 0x00 0x00 0x00 0x01 0x00 0x00 0x9e 0x00 0x00 0x00 0x01 0x00 0x00 0x9f 0x00 0x00 0x00 0x01 0x00 0x00 0xa0 0x00 0x00 0x00 0x01 0x00 0x00 0xa1 0x00 0x00 0x00 0x01 0x00 0x00 0xa2 0x00 0x00 0x00 0x01 0x00 0x00 0xa3 0x00 0x00 0x00 0x01 0x00 0x00>;
		};
	};

	fragment@50 {
		target = <0xffffffff>;

		__overlay__ {
			mediatek,mapping_table_entry = <0x92>;
			mediatek,mapping_table = <0x00 0x00 0x01 0x01 0x02 0x02 0x03 0x03 0x04 0x04 0x05 0x05 0x06 0x06 0x07 0x07 0x08 0x08 0x09 0x09 0x0a 0x0a 0x0b 0x0b 0x0c 0x0c 0x0d 0x0d 0x0e 0x0e 0x0f 0x0f 0x10 0x10 0x11 0x11 0x12 0x12 0x13 0x13 0x14 0x14 0x15 0x15 0x16 0x16 0x17 0x17 0x18 0x18 0x19 0x19 0x1a 0x1a 0x1b 0x1b 0x1c 0x1c 0x1d 0x1d 0x1e 0x1e 0x1f 0x1f 0x20 0x20 0x21 0x21 0x22 0x22 0x23 0x23 0x24 0x24 0x25 0x25 0x26 0x26 0x27 0x27 0x28 0x28 0x29 0x29 0x2a 0x2a 0x2b 0x2b 0x2c 0x2c 0x2d 0x2d 0x2e 0x2e 0x2f 0x2f 0x30 0x30 0x31 0x31 0x32 0x32 0x33 0x33 0x34 0x34 0x35 0x35 0x36 0x36 0x37 0x37 0x38 0x38 0x39 0x39 0x3a 0x3a 0x3b 0x3b 0x3c 0x3c 0x3d 0x3d 0x3e 0x3e 0x3f 0x3f 0x40 0x40 0x41 0x41 0x42 0x42 0x43 0x43 0x44 0x44 0x45 0x45 0x46 0x46 0x47 0x47 0x48 0x48 0x49 0x49 0x4a 0x4a 0x4b 0x4b 0x4c 0x4c 0x4d 0x4d 0x4e 0x4e 0x4f 0x4f 0x50 0x50 0x51 0x51 0x52 0x52 0x53 0x53 0x54 0x54 0x55 0x55 0x56 0x56 0x57 0x57 0x58 0x58 0x59 0x59 0x5a 0x5a 0x5b 0x5b 0x5c 0x5c 0x5d 0x5d 0x5e 0x5e 0x5f 0x5f 0x60 0x60 0x61 0x61 0x62 0x62 0x63 0x63 0x64 0x64 0x65 0x65 0x66 0x66 0x67 0x67 0x68 0x68 0x69 0x69 0x6a 0x6a 0x6b 0x6b 0x6c 0x6c 0x6d 0x6d 0x6e 0x6e 0x6f 0x6f 0x70 0x70 0x71 0x71 0x72 0x72 0x73 0x73 0x74 0x74 0x75 0x75 0x76 0x76 0x77 0x77 0x78 0x78 0x79 0x79 0x7a 0x7a 0x7b 0x7b 0x7c 0x7c 0x7d 0x7d 0x7e 0x7e 0x7f 0x7f 0x80 0x80 0x81 0x81 0x82 0x82 0x83 0x83 0x84 0x84 0x85 0x85 0x98 0x8b 0x99 0x8c 0x9a 0x8d 0x9b 0x8e 0x9c 0x8f 0x9d 0x91 0x9e 0x92 0x9f 0x93 0xa0 0x94 0xa1 0x95 0xa2 0x96 0xa3 0x97>;
			mediatek,builtin_entry = <0x07>;
			mediatek,builtin_mapping = <0x0b 0x02 0x90 0x17 0x02 0x90 0x2e 0x06 0x90 0x29 0x01 0x90 0x00 0x04 0x90 0x6d 0x04 0x90 0x06 0x03 0x90>;
		};
	};

	fragment@51 {
		target = <0xffffffff>;

		__overlay__ {
			interrupt-parent = <0xffffffff>;
			interrupts = <0x00 0x04>;
			debounce = <0x00 0x00>;
			status = "okay";
		};
	};

	fragment@52 {
		target = <0xffffffff>;

		__overlay__ {
			interrupt-parent = <0xffffffff>;
			interrupts = <0x01 0x02>;
			debounce = <0x01 0x00>;
			status = "okay";
		};
	};

	fragment@53 {
		target = <0xffffffff>;

		__overlay__ {
			interrupt-parent = <0xffffffff>;
			interrupts = <0x02 0x04>;
			debounce = <0x02 0x00>;
			status = "okay";
		};
	};

	fragment@54 {
		target = <0xffffffff>;

		__overlay__ {
			interrupt-parent = <0xffffffff>;
			interrupts = <0x03 0x08>;
			debounce = <0x03 0x00>;
			status = "okay";
		};
	};

	fragment@55 {
		target = <0xffffffff>;

		__overlay__ {
			interrupt-parent = <0xffffffff>;
			interrupts = <0x04 0x08>;
			debounce = <0x04 0x00>;
			status = "okay";
		};
	};

	fragment@56 {
		target = <0xffffffff>;

		__overlay__ {
			interrupt-parent = <0xffffffff>;
			interrupts = <0x05 0x08>;
			debounce = <0x05 0x00>;
			status = "okay";
		};
	};

	fragment@57 {
		target = <0xffffffff>;

		__overlay__ {
			interrupt-parent = <0xffffffff>;
			interrupts = <0x29 0x02>;
			debounce = <0x29 0x00>;
			status = "okay";
		};
	};

	fragment@58 {
		target = <0xffffffff>;

		__overlay__ {
			interrupt-parent = <0xffffffff>;
			interrupts = <0x2c 0x01>;
			debounce = <0x2c 0x00>;
			status = "okay";
		};
	};

	fragment@59 {
		target = <0xffffffff>;

		__overlay__ {
			interrupt-parent = <0xffffffff>;
			interrupts = <0x5b 0x08>;
			debounce = <0x5b 0x00>;
			status = "okay";
		};
	};

	fragment@60 {
		target = <0xffffffff>;

		__overlay__ {
			interrupt-parent = <0xffffffff>;
			interrupts = <0xa2 0x04>;
			debounce = <0xa2 0x00>;
			status = "okay";
		};
	};

	fragment@61 {
		target = <0xffffffff>;

		__overlay__ {

			MD1_SIM1_HOT_PLUG_EINT@0 {
				compatible = "mediatek,MD1_SIM1_HOT_PLUG_EINT-eint";
				interrupts = <0x00 0x04>;
				debounce = <0x00 0x186a0>;
				dedicated = <0x00 0x00>;
				src_pin = <0x00 0x01>;
				sockettype = <0x00 0x00>;
				status = "okay";
			};
		};
	};

	fragment@62 {
		target = <0xffffffff>;

		__overlay__ {
			regulator-name = "vcama";
			regulator-default-on = <0x01>;
			status = "okay";
		};
	};

	fragment@63 {
		target = <0xffffffff>;

		__overlay__ {
			regulator-name = "vsim1";
			regulator-default-on = <0x01>;
			status = "okay";
		};
	};

	fragment@64 {
		target = <0xffffffff>;

		__overlay__ {
			regulator-name = "vsim2";
			regulator-default-on = <0x01>;
			status = "okay";
		};
	};

	fragment@65 {
		target = <0xffffffff>;

		__overlay__ {
			regulator-name = "vcamd";
			regulator-default-on = <0x01>;
			status = "okay";
		};
	};

	fragment@66 {
		target = <0xffffffff>;

		__overlay__ {
			regulator-name = "vcamio";
			regulator-default-on = <0x01>;
			status = "okay";
		};
	};

	fragment@67 {
		target = <0xffffffff>;

		__overlay__ {
			regulator-name = "vldo28";
			regulator-default-on = <0x01>;
			status = "okay";
		};
	};

	fragment@68 {
		target = <0xffffffff>;

		__overlay__ {
			vcama-supply = <0xffffffff>;
			vcama_main2-supply = <0xffffffff>;
			vcama_sub-supply = <0xffffffff>;
			vcamd-supply = <0xffffffff>;
			vcamd_main2-supply = <0xffffffff>;
			vcamd_sub-supply = <0xffffffff>;
			vcamio-supply = <0xffffffff>;
			vcamio_main2-supply = <0xffffffff>;
			vcamio_sub-supply = <0xffffffff>;
			vcamaf-supply = <0xffffffff>;
			status = "okay";
		};
	};

	fragment@69 {
		target = <0xffffffff>;

		__overlay__ {
			vtouch-supply = <0xffffffff>;
			status = "okay";
		};
	};

	fragment@70 {
		target = <0xffffffff>;

		__overlay__ {
			mediatek,kpd-key-debounce = <0x400>;
			mediatek,kpd-sw-pwrkey = <0x74>;
			mediatek,kpd-hw-pwrkey = <0x08>;
			mediatek,kpd-sw-rstkey = <0x73>;
			mediatek,kpd-hw-rstkey = <0x11>;
			mediatek,kpd-use-extend-type = <0x00>;
			mediatek,kpd-hw-map-num = <0x48>;
			mediatek,kpd-hw-init-map = <0x72 0x00 0x00 0x00 0x00 0x00 0x00 0x00 0x00 0x00 0x00 0x00 0x00 0x00 0x00 0x00 0x00 0x00 0x00 0x00 0x00 0x00 0x00 0x00 0x00 0x00 0x00 0x00 0x00 0x00 0x00 0x00 0x00 0x00 0x00 0x00 0x00 0x00 0x00 0x00 0x00 0x00 0x00 0x00 0x00 0x00 0x00 0x00 0x00 0x00 0x00 0x00 0x00 0x00 0x00 0x00 0x00 0x00 0x00 0x00 0x00 0x00 0x00 0x00 0x00 0x00 0x00 0x00 0x00 0x00 0x00 0x00>;
			mediatek,kpd-pwrkey-eint-gpio = <0x00>;
			mediatek,kpd-pwkey-gpio-din = <0x00>;
			mediatek,kpd-hw-dl-key0 = <0x11>;
			mediatek,kpd-hw-dl-key1 = <0x00>;
			mediatek,kpd-hw-dl-key2 = <0x08>;
			mediatek,kpd-hw-recovery-key = <0x11>;
			mediatek,kpd-hw-factory-key = <0x00>;
			status = "okay";
		};
	};

	__symbols__ {
		led0 = "/fragment@2/__overlay__/led@0";
		led1 = "/fragment@2/__overlay__/led@1";
		led2 = "/fragment@2/__overlay__/led@2";
		led3 = "/fragment@2/__overlay__/led@3";
		led4 = "/fragment@2/__overlay__/led@4";
		led5 = "/fragment@2/__overlay__/led@5";
		led6 = "/fragment@2/__overlay__/led@6";
		vibrator0 = "/fragment@2/__overlay__/vibrator@0";
		ctp_pins_default = "/fragment@8/__overlay__/eint0default";
		ctp_pins_eint_as_int = "/fragment@8/__overlay__/eint@0";
		ctp_pins_eint_output0 = "/fragment@8/__overlay__/eintoutput0";
		ctp_pins_eint_output1 = "/fragment@8/__overlay__/eintoutput1";
		ctp_pins_rst_output0 = "/fragment@8/__overlay__/rstoutput0";
		ctp_pins_rst_output1 = "/fragment@8/__overlay__/rstoutput1";
		alsps_intpin_cfg = "/fragment@10/__overlay__/alspspincfg";
		alsps_intpin_default = "/fragment@10/__overlay__/alspsdefaultcfg";
		mtkfb_pins_mode_te_gpio = "/fragment@11/__overlay__/mode_te_gpio";
		mtkfb_pins_mode_te_te = "/fragment@11/__overlay__/mode_te_te";
		mtkfb_pins_lcm_reset0 = "/fragment@11/__overlay__/lcm_rst_out0_gpio";
		mtkfb_pins_lcm_reset1 = "/fragment@11/__overlay__/lcm_rst_out1_gpio";
		lcm_power_enp_en0 = "/fragment@11/__overlay__/lcm_power_enp_en@0";
		lcm_power_enp_en1 = "/fragment@11/__overlay__/lcm_power_enp_en@1";
		lcm_power_enn_en0 = "/fragment@11/__overlay__/lcm_power_enn_en@0";
		lcm_power_enn_en1 = "/fragment@11/__overlay__/lcm_power_enn_en@1";
		lcm_power_dm_en0 = "/fragment@11/__overlay__/lcm_power_dm_en@0";
		lcm_power_dm_en1 = "/fragment@11/__overlay__/lcm_power_dm_en@1";
		lcm_power_dp_en0 = "/fragment@11/__overlay__/lcm_power_dp_en@0";
		lcm_power_dp_en1 = "/fragment@11/__overlay__/lcm_power_dp_en@1";
		mtkfb_pins_default = "/fragment@11/__overlay__/mtkfb_default";
		accdet_pins_default = "/fragment@14/__overlay__/accdetdefault";
		accdet_pins_eint_as_int = "/fragment@14/__overlay__/accdeteint@0";
		consys_pins_default = "/fragment@15/__overlay__/consys_default";
		gpslna_pins_init = "/fragment@15/__overlay__/gpslna@0";
		gpslna_pins_oh = "/fragment@15/__overlay__/gpslna@1";
		gpslna_pins_ol = "/fragment@15/__overlay__/gpslna@2";
		fmlna_pins_init = "/fragment@15/__overlay__/fmlna@0";
		fmlna_pins_oh = "/fragment@15/__overlay__/fmlna@1";
		fmlna_pins_ol = "/fragment@15/__overlay__/fmlna@2";
		camera_pins_cam0_mclk_on = "/fragment@17/__overlay__/camera_pins_cam0_mclk_on";
		camera_pins_cam0_mclk_off = "/fragment@17/__overlay__/camera_pins_cam0_mclk_off";
		camera_pins_cam1_mclk_on = "/fragment@17/__overlay__/camera_pins_cam1_mclk_on";
		camera_pins_cam1_mclk_off = "/fragment@17/__overlay__/camera_pins_cam1_mclk_off";
		camera_pins_cam2_mclk_on = "/fragment@17/__overlay__/camera_pins_cam2_mclk_on";
		camera_pins_cam2_mclk_off = "/fragment@17/__overlay__/camera_pins_cam2_mclk_off";
		camera_pins_cam0_rst0 = "/fragment@17/__overlay__/cam0@0";
		camera_pins_cam0_rst1 = "/fragment@17/__overlay__/cam0@1";
		camera_pins_cam0_pnd0 = "/fragment@17/__overlay__/cam0@2";
		camera_pins_cam0_pnd1 = "/fragment@17/__overlay__/cam0@3";
		camera_pins_cam1_rst0 = "/fragment@17/__overlay__/cam1@0";
		camera_pins_cam1_rst1 = "/fragment@17/__overlay__/cam1@1";
		camera_pins_cam1_pnd0 = "/fragment@17/__overlay__/cam1@2";
		camera_pins_cam1_pnd1 = "/fragment@17/__overlay__/cam1@3";
		camera_pins_cam2_rst0 = "/fragment@17/__overlay__/cam2@0";
		camera_pins_cam2_rst1 = "/fragment@17/__overlay__/cam2@1";
		camera_pins_cam2_pnd0 = "/fragment@17/__overlay__/cam2@3";
		camera_pins_cam2_pnd1 = "/fragment@17/__overlay__/cam2@4";
		camera_pins_cam_ldo_rear_vcamd_0 = "/fragment@17/__overlay__/cam0@vcamd0";
		camera_pins_cam_ldo_rear_vcamd_1 = "/fragment@17/__overlay__/cam0@vcamd1";
		camera_pins_cam_ldo_rear_vcama_0 = "/fragment@17/__overlay__/cam0@vcama0";
		camera_pins_cam_ldo_rear_vcama_1 = "/fragment@17/__overlay__/cam0@vcama1";
		camera_pins_cam_ldo_sub_vcamd_0 = "/fragment@17/__overlay__/cam1@vcamd0";
		camera_pins_cam_ldo_sub_vcamd_1 = "/fragment@17/__overlay__/cam1@vcamd1";
		camera_pins_cam_ldo_sub_vcama_0 = "/fragment@17/__overlay__/cam1@vcama0";
		camera_pins_cam_ldo_sub_vcama_1 = "/fragment@17/__overlay__/cam1@vcama1";
		camera_pins_cam_ldo_rear2_vcama_0 = "/fragment@17/__overlay__/cam2@vcama0";
		camera_pins_cam_ldo_rear2_vcama_1 = "/fragment@17/__overlay__/cam2@vcama1";
		camera_pins_af_en_l = "/fragment@17/__overlay__/cam0@af0";
		camera_pins_af_en_h = "/fragment@17/__overlay__/cam0@af1";
		camera_pins_default = "/fragment@17/__overlay__/camdefault";
		fingerprint = "/fragment@19/__overlay__/fingerprint@spi0";
		fpc_pins_default = "/fragment@21/__overlay__/fpcdefault";
		fpc_pins_eint_as_int = "/fragment@21/__overlay__/fpceint@0";
		fpc_pins_rst_high = "/fragment@21/__overlay__/fpcrsthigh";
		fpc_pins_rst_low = "/fragment@21/__overlay__/fpcrstlow";
		fpc_pins_pwr_high = "/fragment@21/__overlay__/fpcpwrhigh";
		fpc_pins_pwr_low = "/fragment@21/__overlay__/fpcpwrlow";
		fpc_mode_as_cs = "/fragment@21/__overlay__/fpccs";
		fpc_mode_as_ck = "/fragment@21/__overlay__/fpcck";
		fpc_mode_as_mi = "/fragment@21/__overlay__/fpcmi";
		fpc_mode_as_mo = "/fragment@21/__overlay__/fpcmo";
		uart0_gpio_def_cfg = "/fragment@23/__overlay__/uart0gpiodefault";
		uart0_rx_set_cfg = "/fragment@23/__overlay__/uart0_rx_set@gpio95";
		uart0_rx_clr_cfg = "/fragment@23/__overlay__/uart0_rx_clear@gpio95";
		uart0_tx_set_cfg = "/fragment@23/__overlay__/uart0_tx_set@gpio96";
		uart0_tx_clr_cfg = "/fragment@23/__overlay__/uart0_tx_clear@gpio96";
		irtx_gpio_led_default = "/fragment@25/__overlay__/irtx_gpio_led_def@gpio58";
		irtx_gpio_led_set = "/fragment@25/__overlay__/irtx_gpio_led_set@gpio58";
		aud_dat_mosi_off = "/fragment@27/__overlay__/aud_dat_mosi_off";
		aud_dat_mosi_on = "/fragment@27/__overlay__/aud_dat_mosi_on";
		aud_dat_miso_off = "/fragment@27/__overlay__/aud_dat_miso_off";
		aud_dat_miso_on = "/fragment@27/__overlay__/aud_dat_miso_on";
		aud_pins_extamp_pullhigh = "/fragment@27/__overlay__/aud_pins_extamp_pullhigh";
		aud_pins_extamp_pulllow = "/fragment@27/__overlay__/aud_pins_extamp_pulllow";
		charger_otg_pins_default = "/fragment@29/__overlay__/charger_otg_default";
		charger_otg_pin_en0 = "/fragment@29/__overlay__/charger_otg_en@0";
		charger_otg_pin_en1 = "/fragment@29/__overlay__/charger_otg_en@1";
		cap_touch_mtk = "/fragment@38/__overlay__/cap_touch@5d";
		msensor_mtk = "/fragment@39/__overlay__/msensor@0c";
		gsensor_mtk = "/fragment@39/__overlay__/gsensor@69";
		barometer_mtk = "/fragment@39/__overlay__/barometer@77";
		speaker_amp_mtk = "/fragment@39/__overlay__/speaker_amp@34";
		ext_buck_lp4_mtk = "/fragment@39/__overlay__/ext_buck_lp4@57";
		ext_buck_lp4x_mtk = "/fragment@39/__overlay__/ext_buck_lp4x@50";
		gyro_mtk = "/fragment@39/__overlay__/gyro@66";
		camera_main_mtk = "/fragment@40/__overlay__/camera_main@1a";
		camera_main_af_mtk = "/fragment@40/__overlay__/camera_main_af@0c";
		camera_main_eeprom_mtk = "/fragment@40/__overlay__/camera_main_eeprom@1b";
		alsps_mtk = "/fragment@41/__overlay__/alsps@67";
		nfc_mtk = "/fragment@41/__overlay__/nfc@08";
		camera_sub_mtk = "/fragment@42/__overlay__/camera_sub@10";
		camera_sub_af_mtk = "/fragment@42/__overlay__/camera_sub_af@0c";
		camera_sub_eeprom_mtk = "/fragment@42/__overlay__/camera_sub_eeprom@1c";
		camera_main_two_eeprom_mtk = "/fragment@42/__overlay__/camera_main_two_eeprom@54";
		mt6370_pmu_mtk = "/fragment@43/__overlay__/mt6370_pmu@34";
		usb_type_c_mtk = "/fragment@43/__overlay__/usb_type_c@4e";
		vgpu_buck_mtk = "/fragment@44/__overlay__/vgpu_buck@6b";
		ccu_sensor_i2c_main_hw_mtk = "/fragment@46/__overlay__/ccu_sensor_i2c_main_hw@33";
		ccu_sensor_i2c_sub_hw_mtk = "/fragment@47/__overlay__/ccu_sensor_i2c_sub_hw@43";
	};

	__fixups__ {
		reserved_memory = "/fragment@0:target:0";
		chosen = "/fragment@1:target:0";
		odm = "/fragment@2:target:0";
		i2c1 = "/fragment@3:target:0\0/fragment@39:target:0";
		i2c3 = "/fragment@4:target:0\0/fragment@34:target:0\0/fragment@41:target:0";
		msdc0 = "/fragment@5:target:0";
		i2c8 = "/fragment@6:target:0\0/fragment@46:target:0";
		touch = "/fragment@7:target:0\0/fragment@52:target:0\0/fragment@69:target:0";
		pio = "/fragment@8:target:0\0/fragment@10:target:0\0/fragment@11:target:0\0/fragment@14:target:0\0/fragment@15:target:0\0/fragment@17:target:0\0/fragment@21:target:0\0/fragment@23:target:0\0/fragment@25:target:0\0/fragment@27:target:0\0/fragment@28/__overlay__:mt6370,intr_gpio:0\0/fragment@29:target:0\0/fragment@31/__overlay__:mt6370pd,intr_gpio:0\0/fragment@32/__overlay__:gpio-rst-std:0\0/fragment@32/__overlay__:gpio-irq-std:0\0/fragment@34/__overlay__/MT5715_receiver@56:irq-gpio:0\0/fragment@34/__overlay__/MT5715_receiver@56:dc-gpio:0\0/fragment@35/__overlay__/spc@40:pdn_pin:0\0/fragment@35/__overlay__/spc@40:rst_pin:0\0/fragment@48/__overlay__:GPIO_SIM2_SIO:0\0/fragment@48/__overlay__:GPIO_SIM2_SRST:0\0/fragment@48/__overlay__:GPIO_SIM2_SCLK:0\0/fragment@48/__overlay__:GPIO_SIM1_SCLK:0\0/fragment@48/__overlay__:GPIO_SIM1_SRST:0\0/fragment@48/__overlay__:GPIO_SIM1_SIO:0\0/fragment@48/__overlay__:GPIO_SIM1_HOT_PLUG:0";
		g_sensor = "/fragment@9:target:0";
		mtkfb = "/fragment@12:target:0\0/fragment@33:target:0";
		accdet = "/fragment@13:target:0";
		eintc = "/fragment@13/__overlay__:interrupt-parent:0\0/fragment@20/__overlay__:interrupt-parent:0\0/fragment@41/__overlay__/alsps@67:interrupt-parent:0\0/fragment@50:target:0\0/fragment@51/__overlay__:interrupt-parent:0\0/fragment@52/__overlay__:interrupt-parent:0\0/fragment@53/__overlay__:interrupt-parent:0\0/fragment@54/__overlay__:interrupt-parent:0\0/fragment@55/__overlay__:interrupt-parent:0\0/fragment@56/__overlay__:interrupt-parent:0\0/fragment@57/__overlay__:interrupt-parent:0\0/fragment@58/__overlay__:interrupt-parent:0\0/fragment@59/__overlay__:interrupt-parent:0\0/fragment@60/__overlay__:interrupt-parent:0\0/fragment@61:target:0";
		consys = "/fragment@16:target:0";
		kd_camera_hw1 = "/fragment@18:target:0\0/fragment@68:target:0";
		spi0 = "/fragment@19:target:0";
		fpc = "/fragment@20:target:0";
		apuart0 = "/fragment@22:target:0";
		irtx_pwm = "/fragment@24:target:0";
		audgpio = "/fragment@26:target:0";
		mt6370_pmu = "/fragment@28:target:0";
		charger = "/fragment@30:target:0";
		mt6370_typec = "/fragment@31:target:0";
		nfc = "/fragment@32:target:0";
		i2c4 = "/fragment@35:target:0\0/fragment@42:target:0";
		auxadc = "/fragment@36:target:0";
		pmic_clock_buffer_ctrl = "/fragment@37:target:0";
		i2c0 = "/fragment@38:target:0";
		i2c2 = "/fragment@40:target:0";
		i2c5 = "/fragment@43:target:0";
		i2c6 = "/fragment@44:target:0";
		i2c7 = "/fragment@45:target:0";
		i2c9 = "/fragment@47:target:0";
		gpio_usage_mapping = "/fragment@48:target:0";
		gpio = "/fragment@49:target:0";
		irq_nfc = "/fragment@51:target:0";
		smart_pa = "/fragment@53:target:0";
		msdc1_ins = "/fragment@54:target:0";
		gyro = "/fragment@55:target:0";
		rt9465_slave_chr = "/fragment@56:target:0";
		mt6370_pd = "/fragment@57:target:0";
		dsi_te = "/fragment@58:target:0";
		mt6370_pmu_eint = "/fragment@59:target:0";
		main_pmic = "/fragment@60:target:0";
		mt_pmic_vcama_ldo_reg = "/fragment@62:target:0\0/fragment@68/__overlay__:vcama-supply:0\0/fragment@68/__overlay__:vcama_main2-supply:0\0/fragment@68/__overlay__:vcama_sub-supply:0";
		mt_pmic_vsim1_ldo_reg = "/fragment@63:target:0";
		mt_pmic_vsim2_ldo_reg = "/fragment@64:target:0";
		mt_pmic_vcamd_ldo_reg = "/fragment@65:target:0\0/fragment@68/__overlay__:vcamd-supply:0\0/fragment@68/__overlay__:vcamd_main2-supply:0\0/fragment@68/__overlay__:vcamd_sub-supply:0";
		mt_pmic_vcamio_ldo_reg = "/fragment@66:target:0\0/fragment@68/__overlay__:vcamio-supply:0\0/fragment@68/__overlay__:vcamio_main2-supply:0\0/fragment@68/__overlay__:vcamio_sub-supply:0";
		mt_pmic_vldo28_ldo_reg = "/fragment@67:target:0\0/fragment@68/__overlay__:vcamaf-supply:0\0/fragment@69/__overlay__:vtouch-supply:0";
		keypad = "/fragment@70:target:0";
	};

	__local_fixups__ {

		fragment@4 {

			__overlay__ {

				alsps@51 {
					pinctrl-0 = <0x00>;
					pinctrl-1 = <0x00>;
				};
			};
		};

		fragment@7 {

			__overlay__ {
				pinctrl-0 = <0x00>;
				pinctrl-1 = <0x00>;
				pinctrl-2 = <0x00>;
				pinctrl-3 = <0x00>;
				pinctrl-4 = <0x00>;
				pinctrl-5 = <0x00>;
			};
		};

		fragment@12 {

			__overlay__ {
				pinctrl-0 = <0x00>;
				pinctrl-1 = <0x00>;
				pinctrl-2 = <0x00>;
				pinctrl-3 = <0x00>;
				pinctrl-4 = <0x00>;
				pinctrl-5 = <0x00>;
				pinctrl-6 = <0x00>;
				pinctrl-7 = <0x00>;
				pinctrl-8 = <0x00>;
				pinctrl-9 = <0x00>;
				pinctrl-10 = <0x00>;
				pinctrl-11 = <0x00>;
				pinctrl-12 = <0x00>;
			};
		};

		fragment@13 {

			__overlay__ {
				pinctrl-0 = <0x00>;
				pinctrl-1 = <0x00>;
			};
		};

		fragment@16 {

			__overlay__ {
				pinctrl-0 = <0x00>;
				pinctrl-1 = <0x00>;
				pinctrl-2 = <0x00>;
				pinctrl-3 = <0x00>;
				pinctrl-4 = <0x00>;
				pinctrl-5 = <0x00>;
				pinctrl-6 = <0x00>;
			};
		};

		fragment@18 {

			__overlay__ {
				pinctrl-0 = <0x00>;
				pinctrl-1 = <0x00>;
				pinctrl-2 = <0x00>;
				pinctrl-3 = <0x00>;
				pinctrl-4 = <0x00>;
				pinctrl-5 = <0x00>;
				pinctrl-6 = <0x00>;
				pinctrl-7 = <0x00>;
				pinctrl-8 = <0x00>;
				pinctrl-9 = <0x00>;
				pinctrl-10 = <0x00>;
				pinctrl-11 = <0x00>;
				pinctrl-12 = <0x00>;
				pinctrl-13 = <0x00>;
				pinctrl-14 = <0x00>;
				pinctrl-15 = <0x00>;
				pinctrl-16 = <0x00>;
				pinctrl-17 = <0x00>;
				pinctrl-18 = <0x00>;
				pinctrl-19 = <0x00>;
				pinctrl-20 = <0x00>;
				pinctrl-21 = <0x00>;
				pinctrl-22 = <0x00>;
				pinctrl-23 = <0x00>;
				pinctrl-24 = <0x00>;
				pinctrl-25 = <0x00>;
				pinctrl-26 = <0x00>;
				pinctrl-27 = <0x00>;
				pinctrl-28 = <0x00>;
				pinctrl-29 = <0x00>;
				pinctrl-30 = <0x00>;
			};
		};

		fragment@20 {

			__overlay__ {
				pinctrl-0 = <0x00>;
				pinctrl-1 = <0x00>;
				pinctrl-2 = <0x00>;
				pinctrl-3 = <0x00>;
				pinctrl-4 = <0x00>;
				pinctrl-5 = <0x00>;
				pinctrl-6 = <0x00>;
				pinctrl-7 = <0x00>;
				pinctrl-8 = <0x00>;
				pinctrl-9 = <0x00>;
			};
		};

		fragment@22 {

			__overlay__ {
				pinctrl-0 = <0x00>;
				pinctrl-1 = <0x00>;
				pinctrl-2 = <0x00>;
				pinctrl-3 = <0x00>;
				pinctrl-4 = <0x00>;
			};
		};

		fragment@24 {

			__overlay__ {
				pinctrl-0 = <0x00>;
				pinctrl-1 = <0x00>;
			};
		};

		fragment@26 {

			__overlay__ {
				pinctrl-0 = <0x00>;
				pinctrl-1 = <0x00>;
				pinctrl-2 = <0x00>;
				pinctrl-3 = <0x00>;
				pinctrl-4 = <0x00>;
				pinctrl-5 = <0x00>;
			};
		};

		fragment@28 {

			__overlay__ {

				charger {
					pinctrl-0 = <0x00>;
					pinctrl-1 = <0x00>;
					pinctrl-2 = <0x00>;
				};
			};
		};
	};
};
